## hw/build/Kconfig/boards/Kconfig.defconfig.tmp
```kconfig
# Load Zephyr board defconfig descriptions.
osource "/home/faiza/zephyrproject/zephyr/boards/st/stm32f746g_disco/Kconfig.defconfig"
```

## hw/build/Kconfig/boards/Kconfig.tmp
```kconfig
# Load Zephyr board Kconfig descriptions.
osource "/home/hijab-fatima-siddiqui/zephyrproject/zephyr/boards/st/stm32f746g_disco/Kconfig"
```

## lab9/build/Kconfig/arch/Kconfig
```kconfig
# Load Zephyr Arch Kconfig descriptions.
osource "/home/faiza/zephyrproject/zephyr/arch/rx/Kconfig"
osource "/home/faiza/zephyrproject/zephyr/arch/x86/Kconfig"
osource "/home/faiza/zephyrproject/zephyr/arch/xtensa/Kconfig"
osource "/home/faiza/zephyrproject/zephyr/arch/sparc/Kconfig"
osource "/home/faiza/zephyrproject/zephyr/arch/riscv/Kconfig"
osource "/home/faiza/zephyrproject/zephyr/arch/posix/Kconfig"
osource "/home/faiza/zephyrproject/zephyr/arch/mips/Kconfig"
osource "/home/faiza/zephyrproject/zephyr/arch/arm64/Kconfig"
osource "/home/faiza/zephyrproject/zephyr/arch/arm/Kconfig"
osource "/home/faiza/zephyrproject/zephyr/arch/arc/Kconfig"
```

## lab9/build/Kconfig/arch/Kconfig.tmp
```kconfig
# Load Zephyr Arch Kconfig descriptions.
osource "/home/hijab-fatima-siddiqui/zephyrproject/zephyr/arch/rx/Kconfig"
osource "/home/hijab-fatima-siddiqui/zephyrproject/zephyr/arch/x86/Kconfig"
osource "/home/hijab-fatima-siddiqui/zephyrproject/zephyr/arch/xtensa/Kconfig"
osource "/home/hijab-fatima-siddiqui/zephyrproject/zephyr/arch/sparc/Kconfig"
osource "/home/hijab-fatima-siddiqui/zephyrproject/zephyr/arch/riscv/Kconfig"
osource "/home/hijab-fatima-siddiqui/zephyrproject/zephyr/arch/posix/Kconfig"
osource "/home/hijab-fatima-siddiqui/zephyrproject/zephyr/arch/mips/Kconfig"
osource "/home/hijab-fatima-siddiqui/zephyrproject/zephyr/arch/arm64/Kconfig"
osource "/home/hijab-fatima-siddiqui/zephyrproject/zephyr/arch/arm/Kconfig"
osource "/home/hijab-fatima-siddiqui/zephyrproject/zephyr/arch/arc/Kconfig"
```

## lab9/build/Kconfig/boards/Kconfig.sysbuild.tmp
```kconfig
# Load Sysbuild board Kconfig descriptions.
osource "/home/faiza/zephyrproject/zephyr/boards/st/stm32f746g_disco/Kconfig.sysbuild"
```
